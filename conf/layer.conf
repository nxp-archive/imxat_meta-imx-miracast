## conf/layer.conf
```bitbake
# We have a conf and classes directory, add to BBPATH
BBPATH .= ":${LAYERDIR}"

# We have a packages directory, add to BBFILES
BBFILES += "${LAYERDIR}/recipes-*/*/*.bb \
            ${LAYERDIR}/recipes-*/*/*.bbappend"

BBFILE_COLLECTIONS += "fsl-embplug-miracast"
BBFILE_PATTERN_fsl-embplug-miracast := "^${LAYERDIR}/"

# Priority above poky/meta (mainly for wpa-supplicant)
# Tips: 'bitbake-layers show-layers' to display layers priorities
BBFILE_PRIORITY_fsl-embplug-miracast = "9"

LAYERVERSION_fsl-embplug-miracast = "1"
LAYERDEPENDS_fsl-embplug-miracast = "core"

LICENSE_PATH += "${LAYERDIR}/files/additional-licenses"

PREFERRED_VERSION_directfb_mx6 = "1.6.3"
PREFERRED_VERSION_wpa-supplicant_mx6 = "2.6"
```
